#include "../headers/NavigationScreen.h"
#include <BLEServer.h>
#include "headers/QR.h"

static const uint16_t PROGMEM link_connected[] = {0xFFFF, 0xFFFF, 0xFFFF, 0xFFFF, 0xFFFF, 0xFFFF, 0xFFFF, 0xFFFF, 0xFFFF, 0xFFFF, 0xFFFF, 0xFFFF, 0x001C,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 0xFFFF, 0xFFFF};
static const uint16_t PROGMEM link_disconnected[] = {0xFFFF, 0xFFFF, 0xFFFF, 0xFFFF, 0xFFFF, 0xFFFF, 0xFFFF, 0xFFFF, 0xFFFF, 0xFFFF, 0xFFFF, 0xFFFF, 0xFFFF,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 0xFFFF, 0xFFFF};
static const uint16_t PROGMEM arrow_right[] = {0xFFFF, 0xFFFF, 0x0000, 0x0000, 0xFFFF, 0xFFFF, 0xFFFF, 0xFFFF, 0xFFFF, 0xFFFF, 0xFFFF, 0xFFFF, 0xFFFF,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 0xFFFF, 0xFFFF};
static const uint16_t PROGMEM arrow_left_invert[] = {0xFFFF, 0xFFFF, 0xFFFF, 0xFFFF, 0xFFFF, 0xFFFF, 0xFFFF, 0xFFFF, 0xFFFF, 0xFFFF, 0xFFFF, 0xFFFF, 0xFFFF,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 0xFFFF, 0xFFFF};

NavigationScreen::NavigationScreen(TFT_eSprite &_tft, bool &_deviceConnected, StateMachine &_stateManager, BLEService **_pService,
                                   TFT_Display &_display,
                                   unsigned long &_currentMillis,
                                   bool &_receivingSec,
                                   bool &_receivingMap,
                                   int &_secBinaryLen,
                                   int &_mapBinaryLen,
                                   unsigned long &_lastDrawTime)
    : tft(&_tft), deviceConnected(&_deviceConnected), stateManager(&_stateManager), pService(_pService), display(&_display),
      currentMillis(&_currentMillis),
      receivingSec(&_receivingSec),
      receivingMap(&_receivingMap),
      secBinaryLen(&_secBinaryLen),
      mapBinaryLen(&_mapBinaryLen),
      lastDrawTime(&_lastDrawTime)
{
  name = "NavigationScreen";
}

class State;

void NavigationScreen::enter()
{
  handleDeviceUpdate();
}

void NavigationScreen::loop()
{
  if ((!*receivingSec && *secBinaryLen >= 5) || (!*receivingMap && *mapBinaryLen >= 5) && *deviceConnected)
  {
    startNavigation();
  }
  else if (prevConnected != *deviceConnected)
  {
    handleDeviceUpdate();
    prevConnected = *deviceConnected;
  }
}

void NavigationScreen::exit()
{
}

void NavigationScreen::btnPress(String button)
{
  Serial.println("NavigationScreen: btnPress: " + button);
  if (button == "LEFT")
  {
    stateManager->changeState("ConfigScreen");
  }
}

void NavigationScreen::handleDeviceUpdate()
{
  Serial.println("NavigationScreen: Device connection status changed: " + String(*deviceConnected ? "Connected" : "Disconnected"));
  tft->createSprite(240, 240);
  tft->fillSprite(TFT_BLACK);
  tft->setFreeFont(&FreeSans12pt7b);
  tft->setTextColor(TFT_WHITE);
  if (*deviceConnected)
  {
    tft->drawString("Start navigation", 43, 102);
    tft->drawString("on the device", 56, 127);
  }
  else
  {
    tft->drawString("No device", 68, 102);
    tft->drawString("Connected", 63, 127);
  }
  tft->fillEllipse(17, 120, 15, 15, 0xFFFF);
  tft->pushImage(7, 110, 20, 20, arrow_left_invert);
  tft->pushSprite(0, 0);
}

void NavigationScreen::startNavigation()
{
  if (*currentMillis - *lastDrawTime >= 33)
  {
    *lastDrawTime = *currentMillis;

#pragma region TiltCompensation
// Tilt-compensated heading
// mpu.update_accel_gyro();
// sensors_event_t magEvent;
// mag.getEvent(&magEvent);

// float ax = mpu.getAccX(), ay = mpu.getAccY(), az = mpu.getAccZ();
// float roll = atan2f(ay, az);
// float pitch = atan2f(-ax, sqrtf(ay * ay + az * az));

// float mx = magEvent.magnetic.x;
// float my = magEvent.magnetic.y;
// float mz = magEvent.magnetic.z;

// float Xh = mx * cosf(pitch) + mz * sinf(pitch);
// float Yh = mx * sinf(roll) * sinf(pitch) + my * cosf(roll) - mz * sinf(roll) * cosf(pitch);

// float heading = atan2f(-Yh, Xh);
// if (heading < 0)
//   heading += 2 * PI;
// float newHeading = heading * 180.0f / M_PI;

// if (!headingInitialized)
// {
//   smoothHeading = newHeading;
//   headingInitialized = true;
// }
// float delta = newHeading - smoothHeading;
// if (delta > 180)
//   delta -= 360;
// if (delta < -180)
//   delta += 360;
// smoothHeading += delta * 0.25f;
// if (smoothHeading < 0)
//   smoothHeading += 360;
// if (smoothHeading >= 360)
//   smoothHeading -= 360;
// heading_degrees = smoothHeading;
#pragma endregion TiltCompensation

    display->drawSecondaryRoads();
  }
  delay(1);
}