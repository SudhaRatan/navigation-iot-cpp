#include "../headers/ConfigScreen.h"
#include <BLEServer.h>
#include "headers/QR.h"

static const uint16_t PROGMEM link_connected[] = {0xFFFF, 0xFFFF, 0xFFFF, 0xFFFF, 0xFFFF, 0xFFFF, 0xFFFF, 0xFFFF, 0xFFFF, 0xFFFF, 0xFFFF, 0xFFFF, 0x001C,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 0xFFFF, 0xFFFF};
static const uint16_t PROGMEM link_disconnected[] = {0xFFFF, 0xFFFF, 0xFFFF, 0xFFFF, 0xFFFF, 0xFFFF, 0xFFFF, 0xFFFF, 0xFFFF, 0xFFFF, 0xFFFF, 0xFFFF, 0xFFFF,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 0xFFFF, 0xFFFF};
static const uint16_t PROGMEM arrow_right[] = {0xFFFF, 0xFFFF, 0x0000, 0x0000, 0xFFFF, 0xFFFF, 0xFFFF, 0xFFFF, 0xFFFF, 0xFFFF, 0xFFFF, 0xFFFF, 0xFFFF,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 0xFFFF, 0xFFFF};

ConfigScreen::ConfigScreen(TFT_eSprite &_tft, bool &_deviceConnected, StateMachine &_stateManager, BLEService **_pService) : tft(&_tft), deviceConnected(&_deviceConnected), stateManager(&_stateManager), pService(_pService)
{
  name = "ConfigScreen";
}

class State;

void ConfigScreen::enter()
{
  qrGen = QRCodeGenerator(*tft);

  std::vector<String> options;
  options.push_back(String(*deviceConnected ? "Connected" : "Disconnected"));
  options.push_back(String(*deviceConnected ? "Disconnect" : "Connect"));
  options.push_back(String("Option 3"));

  std::vector<const uint16_t *> icons;
  icons.push_back(*deviceConnected ? link_connected : link_disconnected);
  icons.push_back(arrow_right);
  icons.push_back(nullptr);

  list = new List(*tft, options, icons);
  list->draw();
}

void ConfigScreen::loop()
{
  if (prevConnected != *deviceConnected)
  {
    Serial.println("ConfigScreen: Device connection status changed: " + String(*deviceConnected));
    std::vector<const uint16_t *> icons;
    icons.push_back(*deviceConnected ? link_connected : link_disconnected);
    icons.push_back(arrow_right);
    icons.push_back(nullptr);

    std::vector<String> options;
    options.push_back(String(*deviceConnected ? "Connected" : "Disconnected"));
    options.push_back(String(*deviceConnected ? "Disconnect" : "Connect"));
    options.push_back(String("Option 3"));

    list->updateItems(options);
    list->updateIcons(icons);
    list->draw();
    prevConnected = *deviceConnected;

    if(*deviceConnected)
    {
      Serial.println("ConfigScreen: Device connected, switching to MainScreen...");
      qrGen.qrPrinted = false; // Reset QR code printed status
      list->draw();
    }
  }
  delay(200);
}

void ConfigScreen::exit()
{
  if (list != nullptr)
  {
    delete list;
    list = nullptr;
  }
}

void ConfigScreen::btnPress(String button)
{
  int selectedIndex = list->getSelectedIndex();
  Serial.println("ConfigScreen: btnPress: " + button);
  if (button == "DOWN")
  {
    if (selectedIndex < list->length() - 1)
    {
      Serial.println("ConfigScreen selectedIndex: " + String(selectedIndex));
      list->setSelectedIndex(selectedIndex + 1);
    }
  }
  else if (button == "UP")
  {
    if (selectedIndex > 0)
    {
      Serial.println("ConfigScreen selectedIndex: " + String(selectedIndex));
      list->setSelectedIndex(selectedIndex - 1);
    }
  }
  else if (button == "RIGHT")
  {
    if (list->getSelectedIndex() == 1)
    {
      if (*deviceConnected)
      {
        Serial.println("ConfigScreen: Disconnecting device...");
        if (*pService != nullptr && (*pService)->getServer()->getConnectedCount() > 0)
        {
          (*pService)->getServer()->disconnect((*pService)->getServer()->getConnId());
        }
      }
      else
      {
        Serial.println("ConfigScreen: Connecting device...");
        
        qrGen.QRPrint();
      }
    }
  }
  else if(button == "LEFT")
  {
    if(qrGen.qrPrinted)
    {
      Serial.println("ConfigScreen: Returning to MainScreen...");
      list->draw();
    }
  }
}